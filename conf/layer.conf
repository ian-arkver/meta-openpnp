## conf/layer.conf
```bitbake
# We have a conf and classes directory, add to BBPATH
BBPATH .= ":${LAYERDIR}"

# We have recipes-* directories, add to BBFILES
BBFILES += "${LAYERDIR}/recipes-*/*/*.bb \
            ${LAYERDIR}/recipes-*/*/*.bbappend"

BBFILE_COLLECTIONS += "meta-openpnp"
BBFILE_PATTERN_meta-openpnp = "^${LAYERDIR}/"
BBFILE_PRIORITY_meta-openpnp = "50"

LAYERDEPENDS_meta-openpnp = "core"
LAYERSERIES_COMPAT_meta-openpnp = "honister"
```
